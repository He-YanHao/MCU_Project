VERSION ""

NS_ :

BS_:
BU_: PC PSU
BO_ 2415984254 CANID_FRAME_0x1001117E: 8 PC
   SG_ ext_flag : 28|1@0+ (1,0) [0|1] "" PC
   SG_ protocol_id : 23|5@0+ (1,0) [0|31] "" PC
   SG_ comm_object : 24|7@0+ (0,0) [0|127] "" PC
   SG_ command_id : 8|8@0+ (0,0) [0|255] "" PC
   SG_ message_source : 7|1@0+ (0,0) [0|1] "" PC
   SG_ group_mask : 2|5@0+ (0,0) [0|31] "" PC
   SG_ address_type : 7|1@0+ (0,0) [0|1] "" PC
   SG_ more_data : 0|1@0+ (0,0) [0|1] "" PC

CM_ BO_ 2415984254 "Virtual frame for CANID bitfield analysis";
CM_ SG_ 2415984254 ext_flag "bit28: fixed to 1";
CM_ SG_ 2415984254 protocol_id "bit27-23: protocol identifier";
CM_ SG_ 2415984254 comm_object "bit22-16: communication object";
CM_ SG_ 2415984254 command_id "bit15-8: command identifier";
CM_ SG_ 2415984254 message_source "bit7: 1=from PSU, 0=to PSU";
CM_ SG_ 2415984254 group_mask "bit6-2: group mask";
CM_ SG_ 2415984254 address_type "bit1: 1=hardware addr, 0=software addr";
CM_ SG_ 2415984254 more_data "bit0: 1=more data follows";
BA_DEF_ BO_ "GenMsgBackgroundColor" STRING ;
BA_DEF_ BO_ "GenMsgForegroundColor" STRING ;
BA_DEF_DEF_ "GenMsgBackgroundColor" "#ffffff";
BA_DEF_DEF_ "GenMsgForegroundColor" "#000000";
